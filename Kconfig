## Kconfig
```kconfig
#
# AoC Driver Support
#

config WC_MBOX
	tristate "Whitechapel Mailbox support"
	depends on MAILBOX
	help
		Say yes here to build the generic mailbox driver for the exynos
		mailboxes in Whitechapel

config AOC_DRIVER
	tristate "WhiteChapel AoC support"
	default n
	depends on WC_MBOX
	help
		Say yes here to add support for the AoC subsystem in WhiteChapel
```

## drivers/misc/inputfilter/Kconfig
```kconfig
config SWEEP2SLEEP
        tristate "Sweep to put device to sleep"
        default y
        help
          Say Y here to support sweep2sleep
```

## drivers/misc/notification/Kconfig
```kconfig
#
# Unprivileged Configuration Interface
#
menu "UCI Notifications Module"
config UCI_NOTIFICATIONS
       default n
       tristate "UCI notifications module"

config UCI_NOTIFICATIONS_SCREEN_CALLBACKS
       default n
       bool "UCI notifications should expose screen state callbacks"
       depends on UCI_NOTIFICATIONS

config UCI_NOTIFICATIONS_DETECT_VIBRATIONS
       default n
       bool "UCI notifications is possible to be detected thru vibration drivers. Set N if not implemented."
       depends on UCI_NOTIFICATIONS

endmenu
```

## drivers/misc/uci/Kconfig
```kconfig
#
# Unprivileged Configuration Interface
#
menu "Unprivileged Configuration Interface"
config UCI
       default n
       tristate "Unprivileged Configuration Interface"

endmenu
```
